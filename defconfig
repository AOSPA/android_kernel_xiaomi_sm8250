## techpack/Kconfig
```kconfig
menu "Tech Packages"

source techpack/data/Kconfig

menu "Camera packages"

config TECHPACK_CUSTOM_CAMERA_XIAOMI
    bool "Xiaomi camera"
    help
      Xiaomi camera

endmenu

endmenu

config OSSFOD
	bool "OSS FOD support"
	depends on BOARD_XIAOMI && !MIHW
	help
	  When this option is enabled, OSS FOD support will be added.
```
